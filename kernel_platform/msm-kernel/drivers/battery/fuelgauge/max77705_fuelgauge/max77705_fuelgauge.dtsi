&smd {
	max77705_fuelgauge: max77705-fuelgauge {
			    /* for 4500mAh battery */
			    status = "okay";
			    fuelgauge,fuel_alert_soc = <1>;
			    fuelgauge,jig_gpio = <SEC_GPIO_REF(AP,tlmm,176) 0>; /* IFC_SENSE_INT_AP */
			    fuelgauge,jig_low_active;
			    fuelgauge,capacity_max = <1000>;
			    fuelgauge,capacity_max_margin = <300>;
			    fuelgauge,capacity_min = <0>;
			    fuelgauge,capacity_calculation_type = <28>;
			    fuelgauge,repeated_fuelalert;
			    fuelgauge,using_temp_compensation;
			    fuelgauge,low_temp_limit = <100>;
			    fuelgauge,vempty_recover_time = <180>; /* 3 mins */
			    fuelgauge,using_hw_vempty;
			    fuelgauge,sw_v_empty_voltage = <3200>;
			    fuelgauge,sw_v_empty_voltage_cisd = <3100>;
			    fuelgauge,sw_v_empty_recover_voltage = <3480>;
			    fuelgauge,fg_resistor = <2>;
#if 1
			    fuelgauge,bat_id_gpio = <
#if 1
					SEC_GPIO_REF(AP,tlmm,97) 0 /* BAT_ID_GPIO 1 */
#endif
					SEC_GPIO_REF(AP,tlmm,10) 0 /* BAT_ID_GPIO 0 */
					>;
#endif
#if 0
			    fuelgauge,sub_bat_id_gpio = <
#if 0
					SEC_GPIO_REF(${sub_bat_id_gpio_2}) 0 /* SUB_BAT_ID_GPIO 1 */
#endif
					SEC_GPIO_REF(${sub_bat_id_gpio}) 0 /* SUB_BAT_ID_GPIO 0 */
					>;
#endif
			    battery_params {
				/* battery0 : default */
				battery0,v_empty = <0xA7E2>; /* Empty: 3350mV, Recover: 3920mV */
				battery0,v_empty_origin = <0x7D54>; /* Empty: 2500mV, Recover: 3360mV */
				battery0,capacity = <0x0FEF>;
				/* fullcapnom(=capacity), dPacc, dQacc,  rcomp0, tempco */
				battery0,fg_reset_wa_data = <0x0FEF 0x3200 0x03FB 0x003A 0x2534>;

				/* battery1 */
				battery1,v_empty = <0xA7E2>; /* Empty: 3350mV, Recover: 3920mV */
				battery1,v_empty_origin = <0x7D54>; /* Empty: 2500mV, Recover: 3360mV */
				battery1,capacity = <0x0FFF>;
				/* fullcapnom(=capacity), dPacc, dQacc,  rcomp0, tempco */
				battery1,fg_reset_wa_data = <0x0FFF 0x3200 0x03FB 0x003A 0x2534>;
			    };
		    };
};

/* /home/dpi/qb5_8814/workspace/P4_1716/android/kernel_platform/kmodule/battery/stable/dm/fuelgauge/max77705/dm3q/max77705_fuelgauge.dtsi */
&max77705_fuelgauge {
	fuelgauge,capacity_calculation_type = <0x5C>;
	fuelgauge,lost_soc_trig_soc = <1000>; /* 100.0% */
	fuelgauge,lost_soc_trig_d_soc = <20>; /* 2% */
	fuelgauge,lost_soc_trig_scale = <2>; /* 2x */
	fuelgauge,lost_soc_guarantee_soc = <30>; /* 3.0% */
	fuelgauge,lost_soc_min_vol = <3200>; /* 3200mV */
	fuelgauge,fg_resistor = <5>; /* 2 milliohm */
	fuelgauge,scale_to_102;

	battery_params {
		/*
		 * BAT_ID_1/BAT_ID_2
		 * 11: SDI, 10: ATL
		 * 01: TBD, 00: TBD
		 */

		/* 00 : battery data */
		battery0,v_empty = <0xA561>; /* Empty: 3400mV, Recover: 4000mV */
		battery0,v_empty_origin = <0x7D54>; /* Empty: 2500mV, Recover: 3360mV */
		battery0,capacity = <0x076B>;
					/* fullcapnom dPacc dQacc RCOMP0 TempCo */
		battery0,fg_reset_wa_data = <0x076A 0x3200 0x01DA 0x002F 0x171F>;

		battery0,data_ver = <0x2>;

			battery0,atRate = <0x1900>; //2100mA
			battery0,config = <0x0210>; //0x0110 (FGCC disabled & Thermistor disable)
			battery0,config2 = <0x0050>; //TAlrtEn as 1 & OCVQen enable
			battery0,convgCfg = <0x2440>;
			battery0,fullcaprep = <0x076A>;
			battery0,fullsocthr = <0x5F00>; //95%
			battery0,iavg_empty = <0x05EF>;
			battery0,learnCFG = <0x2606>;
			battery0,misccfg = <0x3850>; //0x0870 (MixRate as 1.875000 mA)
			battery0,cv_mixCap = <0x1356>; //CV_MixCap (2475mA) is 75% of FullCapNom (0x17FA ; 3300mAh)
			battery0,cv_HalfTime = <0x0600>; //18 minutes --> 30*60/(0.1758125*4) = 1536 = 0x0600
			battery0,tempNom = <0x1403>;
			battery0,tempLim = <0x1E05>;

			/* Address 0x80h starts here */
			battery0,cell_character0 = <
				0xa780 0xb360 0xb890 0xbac0 0xbc90 0xbcf0 0xbd80 0xbe30
				0xbf80 0xc040 0xc240 0xc2b0 0xc9b0 0xce60 0xd500 0xdaf0
			>;
			/* Address 0x90h starts here */
			battery0,cell_character1 = <
				0x0100 0x0600 0x1100 0x0cf0 0x2a10 0x1a40 0x1700 0x0f00
				0x1ab0 0x0cf0 0x0c80 0x07d0 0x07f0 0x06d0 0x06f0 0x06f0
			>;
			/* Address 0xA0h starts here */
			battery0,cell_character2 = <
				0x0200 0x0200 0x0200 0x0200 0x0200 0x0200 0x0200 0x0200
				0x0200 0x0200 0x0200 0x0200 0x0200 0x0200 0x0200 0x0200
			>;

		battery0,selected_reg = <
			0x02 0x7F80	/* default */
			0x12 0x3C00	/* QResidual00 */
			0x1E 0x026C	/* ICHGTerm */
			0x21 0x6200	/* default */
			0x22 0x1D00	/* QResidual10 */
			0x2A 0x023C	/* RelaxCFG */
			0x2C 0xE3E1	/* TGAIN */
			0x2D 0x290E	/* TOFF */
			0x2E 0x0400	/* CGAIN */
			0x2F 0x0001	/* COFF */
			0x32 0x0D80	/* QResidual20 */
			0x33 0xFFFF	/* default */
			0x37 0x05E0	/* default */
			0x42 0x0B00	/* QResidual30 */
			0xB4 0x7F80	/* default */
			0xB8 0x0000	/* default */
			0xB9 0x006B	/* default */
			0xBA 0x090C	/* default */
			>;

		/* 01 : battery data */
		battery1,v_empty = <0xA561>; /* Empty: 3400mV, Recover: 4000mV */
		battery1,v_empty_origin = <0x7D54>; /* Empty: 2500mV, Recover: 3360mV */
		battery1,capacity = <0x076B>;
					/* fullcapnom dPacc dQacc RCOMP0 TempCo */
		battery1,fg_reset_wa_data = <0x076A 0x3200 0x01DA 0x002F 0x171F>;

		battery1,data_ver = <0x2>;

			battery1,atRate = <0x1900>; //2100mA
			battery1,config = <0x0210>; //0x0110 (FGCC disabled & Thermistor disable)
			battery1,config2 = <0x0050>; //TAlrtEn as 1 & OCVQen enable
			battery1,convgCfg = <0x2440>;
			battery1,fullcaprep = <0x076A>;
			battery1,fullsocthr = <0x5F00>; //95%
			battery1,iavg_empty = <0x05EF>;
			battery1,learnCFG = <0x2606>;
			battery1,misccfg = <0x3850>; //0x0870 (MixRate as 1.875000 mA)
			battery1,cv_mixCap = <0x1356>; //CV_MixCap (2475mA) is 75% of FullCapNom (0x17FA ; 3300mAh)
			battery1,cv_HalfTime = <0x0600>; //18 minutes --> 30*60/(0.1758125*4) = 1536 = 0x0600
			battery1,tempNom = <0x1403>;
			battery1,tempLim = <0x1E05>;

			/* Address 0x80h starts here */
			battery1,cell_character0 = <
				0xa780 0xb360 0xb890 0xbac0 0xbc90 0xbcf0 0xbd80 0xbe30
				0xbf80 0xc040 0xc240 0xc2b0 0xc9b0 0xce60 0xd500 0xdaf0
			>;
			/* Address 0x90h starts here */
			battery1,cell_character1 = <
				0x0100 0x0600 0x1100 0x0cf0 0x2a10 0x1a40 0x1700 0x0f00
				0x1ab0 0x0cf0 0x0c80 0x07d0 0x07f0 0x06d0 0x06f0 0x06f0
			>;
			/* Address 0xA0h starts here */
			battery1,cell_character2 = <
				0x0200 0x0200 0x0200 0x0200 0x0200 0x0200 0x0200 0x0200
				0x0200 0x0200 0x0200 0x0200 0x0200 0x0200 0x0200 0x0200
			>;

		battery1,selected_reg = <
			0x02 0x7F80	/* default */
			0x12 0x3C00	/* QResidual00 */
			0x1E 0x026C	/* ICHGTerm */
			0x21 0x6200	/* default */
			0x22 0x1D00	/* QResidual10 */
			0x2A 0x023C	/* RelaxCFG */
			0x2C 0xE3E1	/* TGAIN */
			0x2D 0x290E	/* TOFF */
			0x2E 0x0400	/* CGAIN */
			0x2F 0x0001	/* COFF */
			0x32 0x0D80	/* QResidual20 */
			0x33 0xFFFF	/* default */
			0x37 0x05E0	/* default */
			0x42 0x0B00	/* QResidual30 */
			0xB4 0x7F80	/* default */
			0xB8 0x0000	/* default */
			0xB9 0x006B	/* default */
			0xBA 0x090C	/* default */
			>;

		/* 10 : ATL battery data */
		battery2,v_empty = <0xA561>; /* Empty: 3400mV, Recover: 4000mV */
		battery2,v_empty_origin = <0x7D54>; /* Empty: 2500mV, Recover: 3360mV */
		battery2,capacity = <0x0744>;
					/* fullcapnom dPacc dQacc RCOMP0 TempCo */
		battery2,fg_reset_wa_data = <0x0744 0x3200 0x01D1 0x002C 0x161F>;

		battery2,data_ver = <0x4>;

			battery2,atRate = <0x1900>; //2100mA
			battery2,config = <0x0210>; //0x0110 (FGCC disabled & Thermistor disable)
			battery2,config2 = <0x0050>; //TAlrtEn as 1 & OCVQen enable
			battery2,convgCfg = <0x2440>;
			battery2,fullcaprep = <0x0744>;
			battery2,fullsocthr = <0x5F00>; //95%
			battery2,iavg_empty = <0x05D0>;
			battery2,learnCFG = <0x2606>;
			battery2,misccfg = <0x3870>; //0x0870 (MixRate as 1.875000 mA)
			battery2,cv_mixCap = <0x1356>; //CV_MixCap (2475mA) is 75% of FullCapNom (0x17FA ; 3300mAh)
			battery2,cv_HalfTime = <0x0600>; //18 minutes --> 30*60/(0.1758125*4) = 1536 = 0x0600
			battery2,tempNom = <0x1403>;
			battery2,tempLim = <0x1E05>;

			/* Address 0x80h starts here */
			battery2,cell_character0 = <
				0xa740 0xb7b0 0xba10 0xbaf0 0xbc20 0xbd60 0xbe90 0xbfc0
				0xc150 0xc2e0 0xc6c0 0xc930 0xca90 0xcf20 0xd610 0xdb70
			>;
			/* Address 0x90h starts here */
			battery2,cell_character1 = <
				0x01c0 0x1180 0x0a60 0x13c0 0x14b0 0x17b0 0x1490 0x1020
				0x0c20 0x0810 0x0830 0x06f0 0x0830 0x06d0 0x07a0 0x07a0
			>;
			/* Address 0xA0h starts here */
			battery2,cell_character2 = <
				0x0200 0x0200 0x0200 0x0200 0x0200 0x0200 0x0200 0x0200
				0x0200 0x0200 0x0200 0x0200 0x0200 0x0200 0x0200 0x0200
			>;

		battery2,selected_reg = <
			0x02 0x7F80	/* default */
			0x12 0x2F00	/* QResidual00 */
			0x1E 0x026C	/* ICHGTerm */
			0x21 0x6200	/* default */
			0x22 0x1800	/* QResidual10 */
			0x2A 0x023C	/* RelaxCFG */
			0x2C 0xE3E1	/* TGAIN */
			0x2D 0x290E	/* TOFF */
			0x2E 0x0400	/* CGAIN */
			0x2F 0x0001	/* COFF */
			0x32 0x0C80	/* QResidual20 */
			0x33 0xFFFF	/* default */
			0x37 0x05E0	/* default */
			0x42 0x0900	/* QResidual30 */
			0xB4 0x7F80	/* default */
			0xB8 0x0000	/* default */
			0xB9 0x006B	/* default */
			0xBA 0x090C	/* default */
			>;

		/* 11 : SDI battery data */
		battery3,v_empty = <0xA561>; /* Empty: 3400mV, Recover: 4000mV */
		battery3,v_empty_origin = <0x7D54>; /* Empty: 2500mV, Recover: 3360mV */
		battery3,capacity = <0x0738>;
					/* fullcapnom dPacc dQacc RCOMP0 TempCo */
		battery3,fg_reset_wa_data = <0x0738 0x3200 0x01CE 0x002F 0x161F>;

		battery3,data_ver = <0x3>;

			battery3,atRate = <0x1900>; //2100mA
			battery3,config = <0x0210>; //0x0110 (FGCC disabled & Thermistor disable)
			battery3,config2 = <0x0050>; //TAlrtEn as 1 & OCVQen enable
			battery3,convgCfg = <0x2440>;
			battery3,fullcaprep = <0x0738>;
			battery3,fullsocthr = <0x5F00>; //95%
			battery3,iavg_empty = <0x05C6>;
			battery3,learnCFG = <0x2606>;
			battery3,misccfg = <0x3870>; //0x0870 (MixRate as 1.875000 mA)
			battery3,cv_mixCap = <0x1356>; //CV_MixCap (2475mA) is 75% of FullCapNom (0x17FA ; 3300mAh)
			battery3,cv_HalfTime = <0x0600>; //18 minutes --> 30*60/(0.1758125*4) = 1536 = 0x0600
			battery3,tempNom = <0x1403>;
			battery3,tempLim = <0x1E05>;

			/* Address 0x80h starts here */
			battery3,cell_character0 = <
				0xa1b0 0xb610 0xb6f0 0xb8c0 0xbad0 0xbc60 0xbda0 0xbe90
				0xc060 0xc3a0 0xc780 0xcaa0 0xce10 0xd1c0 0xd550 0xdb20
			>;
			/* Address 0x90h starts here */
			battery3,cell_character1 = <
				0x00f0 0x0e50 0x0950 0x0c60 0x0e20 0x2420 0x0ea0 0x1790
				0x0b20 0x0810 0x07f0 0x0710 0x0800 0x0700 0x0720 0x0720
			>;
			/* Address 0xA0h starts here */
			battery3,cell_character2 = <
				0x0200 0x0200 0x0200 0x0200 0x0200 0x0200 0x0200 0x0200
				0x0200 0x0200 0x0200 0x0200 0x0200 0x0200 0x0200 0x0200
			>;

		battery3,selected_reg = <
			0x02 0x7F80	/* default */
			0x12 0x3B00	/* QResidual00 */
			0x1E 0x026C	/* ICHGTerm */
			0x21 0x6200	/* default */
			0x22 0x1E80	/* QResidual10 */
			0x2A 0x023C	/* RelaxCFG */
			0x2C 0xE3E1	/* TGAIN */
			0x2D 0x290E	/* TOFF */
			0x2E 0x0400	/* CGAIN */
			0x2F 0x0001	/* COFF */
			0x32 0x1000	/* QResidual20 */
			0x33 0xFFFF	/* default */
			0x37 0x05E0	/* default */
			0x42 0x0D80	/* QResidual30 */
			0xB4 0x7F80	/* default */
			0xB8 0x0000	/* default */
			0xB9 0x006B	/* default */
			0xBA 0x090C	/* default */
			>;
	};
};
