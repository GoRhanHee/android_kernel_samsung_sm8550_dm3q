## custom_defconfigs/gorhanhee_defconfig
```kconfig
# Disable Samsung anti-root protection
CONFIG_UH=n
CONFIG_RKP=n
CONFIG_KDP=n
CONFIG_SECURITY_DEFEX=n
CONFIG_PROCA=n
CONFIG_FIVE=n

# Disable Werror
CONFIG_WERROR=n

# Add LOCALVERSION
CONFIG_LOCALVERSION="-GoRhanHee_Kernel_dm3q"
CONFIG_LOCALVERSION_AUTO=n
```
